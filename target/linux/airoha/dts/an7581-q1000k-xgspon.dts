// SPDX-License-Identifier: GPL-2.0-or-later OR MIT
#include "an7581-q1000k.dts"
#include "an7581-q1000k-xgspon-hardware.dtsi"

/ {
	/* Enables the normal supervisor path; UCI still controls activation. */
	quantum,xgspon-service;
};
